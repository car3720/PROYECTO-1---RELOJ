;***************************************************************************************
; Universidad del Valle de Guatemala
; IE2023: Programación de Microcontroladores
; PROYECTO RELOJ
; Autor: Diego Cardona
; Proyecto 1
; Hardware: ATMEGA328P
; Creado: 25/02/2024
; Última modificación: 25/02/2024
;***************************************************************************************

;****************************************************************
; ENCABEZADO


// Encabezado (Definición de Registros, Variables y Constantes)
.include "m328PBdef.inc"     // Include definitions specific to ATMega328PB
.cseg
.org 0x0000		//EN LA DIRECCIÓN 0x0000 EL CÓDIGO INICIA EN ESTA DIRECCIÓN 
	JMP START	//SALTA A DONDE ENCUENTRE LA ETIQUETA "START"

.org 0x0006
	JMP INT_PC  //INTERRUPCION DE PINES
.org 0x001A
	JMP TMR1_ISR  //INTERRUPCION TIMER 1
.org 0x0020
	JMP TMR0_ISR  //INTERRUPCION TIMER 0

;	TABLA DE 7 SEGMENTOS
TABLA7SEG:		.DB		0x3F, 0x06, 0x5B, 0x4F, 0x66, 0x6D, 0x7D, 0x07, 0x7F, 0x6F

START:
 /****************************************/
// Configuración de la pila
	LDI     R16, LOW(RAMEND)
	OUT     SPL, R16
	LDI     R16, HIGH(RAMEND)
	OUT     SPH, R16
/****************************************/

// Configuracion MCU
SETUP:
	CLI ; DESHABILITA INTERRUPCIONES GLOBALES (BORRA I BIT EN SREG)

	
	LDI		R16, 0b1000_0000	; EL TIMER SE ESTABLECE A 8Mhz
	LDI		R16, (1 << CLKPCE)	; HABILITAR CAMBIO DE PREESCALER
	STS		CLKPR, R16		

	//CONFIGURACIÓN DE ENTRADAS PARA BOTONES DE DISPLAYS EN PUERTO B  Y QUE TENGAN PULL UP ACTIVADO
	LDI		R16, 0b0001_1111
	OUT		PORTB, R16

	LDI		R16, 0b0010_0000
	OUT		DDRB, R16
	

	//CONFIGURACIÓN DE SALIDAS PARA ACTIVACIÓN DE DISPLAYS EN PUERTO C, PC0 - PC3 (TRANSISTORES)
	LDI		R16, 0b0011_1111
	OUT		DDRC, R16
	LDI		R16, 0b1100_0000
	OUT		PORTC, R16
	

	// CONFIGURAR TODO EL PUERTO D COMO SALIDA
	LDI		R16, 0b1111_1111
	OUT		DDRD, R16	

	


	// CONFIGURANDO INTERRUPCIONES PARA PB0 y PB1 (PIN CHANGE)
	LDI R16, (1<<PCINT4) |(1<<PCINT3) |(1<<PCINT2) |(1<<PCINT1) | (1<<PCINT0)    //SE ESTABLECEN LOS PINES 0 Y 4 DEL PUERTO B COMO INTERRUPCIONES
	STS PCMSK0, R16
	LDI R16, (1<<PCIE0)	; HABILITAR INTERRUPCIONES DE PIN CHANGE PARA EL PUERTO B
	STS PCICR, R16

	// HABILITAR RX Y TX COMO SALIDAS PARA EL DISPLAY	
	LDI	R16, 0x00
	STS	UCSR0B, R16
	LDI R16, (1<<PCIE0)

	// HABILITAR INTERRUPCIONES GLOBALES (SETEA I BIT EN SREG)
	SEI


	LDI		R24, 0x01
	//	REGISTROS PARA RELOJ
	// CARGANDO VALORES DE 0 A LOS REGISTROS DE RELOJ
	LDI		R16, 0x00 // SE GUARDA LOS VALORES DEL PUERTO B EN ESTE REGISTRO
	LDI		R17, 0x00 // CARGARÁ LOS VALORES A CADA DISPLAY A TRAVÉS DE LPM 
	LDI		R18, 0x09 // UNIDADES DE MINUTOS
	LDI		R19, 0x05 // DECENAS DE MINUTOS
	LDI		R20, 0x03 // UNIDADES DE HORAS
	LDI		R21, 0x02 // DECENAS DE HORAS
	LDI		R22, 0x06 // RESET
	LDI		R23, 0x00 // MODO HORA


	

//****************************************************
// LOOP INFINITO
// ***************************************************


//MAIN LOOP: SERVIRÁ PARA UNA REVISIÓN DE ESTADO CONSTANTE
MAIN_LOOP:


	CPI		R24, 0	;HORA
	BREQ	MODO_HORA_HAB
	CPI		R24, 1	;CONFIGURACIÓN DE HORA
	BREQ	MODO_CONF_HORA_HAB

	JMP		MAIN_LOOP


MODO_HORA_HAB:
	RJMP	MODO_HORA	;SALTO A LA FUNCIÓN DE HORA

MODO_CONF_HORA_HAB:
	RJMP	MODO_CONF_HORA	;SALTO A LA FUNCIÓN DE LA CONFIGURACIÓN DE HORA


;	MODO HORA
MODO_HORA:
	CPI		R17, 60		;COMPARA EL REGISTRO 28 CON 60 PARA VERIFICAR SI LLEGO A 60 SEGUNDOS E INCREMENTA LA UNIDAD DE MINUTO
	BREQ	MIN_UNITS
	CPI		R18, 10		;COMPARA EL REGISTRO 21 CON 10 PARA VERIFICAR SI LLEGO A 10 LAS UNIDAD DE MINUTOS E INCREMENTA LA DECENA DE MINUTO
	BREQ	MIN_DEC
	CPI		R19, 6		;COMPARA EL REGISTRO 22 CON 6 PARA VERIFICAR SI LLEGO A 6 LA DECENA DE MINUTO E INCREMENTA LA UNIDAD DE HORA
	BREQ	HORA_UNITS
	CPI		R20, 10		;COMPARA SI EL REGISTRO 23 CON 10 PARA VERIFICAR SI LLEGO A 10 LA UNIDAD DE HORA E INCREMENTA LA DECENA DE HORA
	BREQ	HORA_DEC
	CPI		R21, 2		;PARA EL FORMATO DE 24 HRS, COMPARA SI EL REGISTRO 24 ES IGUAL A 2 Y SI LLEGÓ VA A UN PEQUEÑO DELAY QUE RESETEARÁ NUEVAMENTE TODO PARA PONERLO A 0
	BREQ	REST_24

MOSTRAR_HORA:

	; UNIDADES DE MINUTOS, PRIMER DÍGITO DE DISPLAY
	
	CALL	DELAY		// LLAMA A UN DELAY PROGRAMADO
	LDI R16, 0b0010_0001
	OUT PORTC, R16


	; CARGA DE VALORES DE LA TABLA DE 7 SEGMENTOS AL DISPLAY
	LDI ZH, HIGH(TABLA7SEG << 1)  
	LDI ZL, LOW(TABLA7SEG << 1)
	ADD ZL, R18			//AGREGA E INDICA QUE R19 INCIARÁ DESDE EL VALOR MÁS BAJO DE LA TABLA; ES DECIR, DESDE 0
	LPM R25, Z			// CARGA EL VALOR DE Z QUE SE LE CARGO EN LA LÍNEA 147 AL REGISTRO 18	
	OUT PORTD, R25		// MUESTRA EL VALOR DE R17 EN EL DISPLAY  
	
	CALL DELAY

	; DECENAS DE MINUTOS, SEGUNDO DÍGITO DE DISPLAY
	LDI		R16, 0b0000_0010	//ENCIENDE EL SEGUNDO DISPLAY; ES DECIR, ENCIENDE EL SEGUNDO TRANSISTOR EN A1, QUE MUESTRA DECENAS DE MINUTOS
	OUT		PORTC, R16

	; CARGA DE VALORES DE LA TABLA DE 7 SEGMENTOS AL DISPLAY
	LDI ZH, HIGH(TABLA7SEG << 1)  
	LDI ZL, LOW(TABLA7SEG << 1)
	ADD ZL, R20			//AGREGA E INDICA QUE R20 INCIARÁ DESDE EL VALOR MÁS BAJO DE LA TABLA; ES DECIR, DESDE 0
	LPM R25, Z			// CARGA EL VALOR DE Z QUE SE LE CARGO EN LA LÍNEA 161 AL REGISTRO 18	
	OUT PORTD, R25		// MUESTRA EL VALOR DE R17 EN EL DISPLAY  
	
	CALL DELAY
	

	; UNIDADES DE HORAS, TERCER DÍGITO DE DISPLAY
	LDI		R16, 0b0000_0100	//ENCIENDE EL TERCER DISPLAY; ES DECIR, ENCIENDE EL TERCER TRANSISTOR EN A2, QUE MUESTRA UNIDADES DE HORAS
	OUT		PORTC, R16

	; CARGA DE VALORES DE LA TABLA DE 7 SEGMENTOS AL DISPLAY
	LDI ZH, HIGH(TABLA7SEG << 1)  
	LDI ZL, LOW(TABLA7SEG << 1)
	ADD ZL, R21			//AGREGA E INDICA QUE R21 INCIARÁ DESDE EL VALOR MÁS BAJO DE LA TABLA; ES DECIR, DESDE 0
	LPM R25, Z			// CARGA EL VALOR DE Z QUE SE LE CARGO EN LA LÍNEA 175 AL REGISTRO 18	
	OUT PORTD, R25		// MUESTRA EL VALOR DE R17 EN EL DISPLAY  
	
	CALL DELAY
	
	; DECENAS DE HORAS, CUARTO DÍGITO DE DISPLAY
	LDI		R16, 0b0000_0100	//ENCIENDE EL TERCER DISPLAY; ES DECIR, ENCIENDE EL TERCER TRANSISTOR EN A2, QUE MUESTRA UNIDADES DE HORAS
	OUT		PORTC, R16

	; CARGA DE VALORES DE LA TABLA DE 7 SEGMENTOS AL DISPLAY
	LDI ZH, HIGH(TABLA7SEG << 1)  
	LDI ZL, LOW(TABLA7SEG << 1)
	ADD ZL, R23			//AGREGA E INDICA QUE R23 INCIARÁ DESDE EL VALOR MÁS BAJO DE LA TABLA; ES DECIR, DESDE 0
	LPM R25, Z			// CARGA EL VALOR DE Z QUE SE LE CARGO EN LA LÍNEA 161 AL REGISTRO 18	
	OUT PORTD, R25		// MUESTRA EL VALOR DE R17 EN EL DISPLAY  
	
	CALL DELAY
	
	RJMP		MAIN_LOOP

MIN_UNITS:                //CADA MINUTO SE CAMBIA EL VALOR DEL DISPLAY 1
	LDI R17, 0
	INC R18
	RJMP MODO_HORA
MIN_DEC:                //CADA 10 MINUTOS SE CAMBIA EL VALOR PARA PONER LAS DECENAS 
	LDI R18, 0
	INC R19
	RJMP MODO_HORA
HORA_UNITS: 				// CADA 60 MINUTOS SE CAMBIA LA HORA 
	LDI R19, 0
	INC R20
	RJMP MODO_HORA
HORA_DEC:				//CCUANDO LLEGUE A 10 SE CAMBIAN LAS DECENAS 
	LDI R20, 0
	INC R21
	RJMP MODO_HORA
REST_24:
	CPI R19, 4			//CUANDO ALCANCE LAS 24 HRS UNIDADES Y DECENAS DE HORAS
	BREQ RESET_ALL
	RJMP MOSTRAR_HORA
RESET_ALL: 
	LDI		R18, 0 // REGISTRO DE UNIDADES DE MINUTOS
	LDI		R19, 0 // REGISTRO DE DECENAS DE MINUTOS
	LDI		R20, 0 // REGISTRO DE UNIDADES DE HORAS
	LDI		R21, 0 // REGISTRO DE DECENAS DE HORAS
	INC		R22	   // REGISTRO PARA RESET
	RJMP	MODO_HORA

; MODO DE CONFIGURACIÓN DE HORA
MODO_CONF_HORA:

	CPI		R18, 10		// COMPARA SI EL REGISTRO DE UNIDADES DE MINUTOS INCREMENTA O DECREMENTA A LLEGANDO A TENER UN VALOR DE 10
	BREQ	MIN_DEC_CONF	// SI NO SE CUMPLE LA COMPARACIÓN SE SALTA A LA FUNCIÓN DE CONFIGURACIÓN DE UNIDAD DE MINUTOS
	CPI		R19, 6		// COMPARA SI EL REGISTRO DE DECENAS DE MINUTOS INCREMENTA O DECREMENTA A LLEGANDO A TENER UN VALOR DE 6
	BREQ	HORA_UNITS_CONF	// SI NO SE CUMPLE LA COMPARACIÓN SE SALTA A LA FUNCIÓN DE CONFIGURACIÓN DE DECENAS DE MINUTOS
	CPI		R20, 10		// COMPARA SI EL REGISTRO DE UNIDADES DE HORAS INCREMENTA O DECREMENTA A LLEGANDO A TENER UN VALOR DE 10
	BREQ	HORA_DEC_CONF	// SI NO SE CUMPLE LA COMPARACIÓN SE SALTA A LA FUNCIÓN DE CONFIGURACIÓN DE UNIDAD DE HORAS
	CPI		R21, 2		// COMPARA SI EL REGISTRO DE DECENAS DE HORAS INCREMENTA O DECREMENTA A LLEGANDO A TENER UN VALOR DE 2
	BREQ	REST_24_CONF

MODO_CONF_MOSTRAR_HORA:
	CALL	DELAY		// LLAMA A UN DELAY PROGRAMADO
	LDI R16, 0b0010_0001
	OUT PORTC, R16

	; UNIDADES DE MINUTOS, PRIMER DÍGITO DE DISPLAY
	LDI		R16, 0b0000_0001	//ENCIENDE EL PRIMER DISPLAY Y APAGA LOS DEMÁS; ES DECIR, ENCIENDE EL PRIMER TRANSISTOR EN A0, QUE MUESTRA UNIDADES DE MINUTOS
	OUT		PORTC, R16

	; CARGA DE VALORES DE LA TABLA DE 7 SEGMENTOS AL DISPLAY
	LDI ZH, HIGH(TABLA7SEG << 1)  
	LDI ZL, LOW(TABLA7SEG << 1)
	ADD ZL, R18			//AGREGA E INDICA QUE R19 INCIARÁ DESDE EL VALOR MÁS BAJO DE LA TABLA; ES DECIR, DESDE 0
	LPM R25, Z			// CARGA EL VALOR DE Z QUE SE LE CARGO EN LA LÍNEA 147 AL REGISTRO 18	
	OUT PORTD, R25		// MUESTRA EL VALOR DE R17 EN EL DISPLAY  
	
	CALL DELAY

	; DECENAS DE MINUTOS, SEGUNDO DÍGITO DE DISPLAY
	LDI		R16, 0b0000_0010	//ENCIENDE EL SEGUNDO DISPLAY; ES DECIR, ENCIENDE EL SEGUNDO TRANSISTOR EN A1, QUE MUESTRA DECENAS DE MINUTOS
	OUT		PORTC, R16

	; CARGA DE VALORES DE LA TABLA DE 7 SEGMENTOS AL DISPLAY
	LDI ZH, HIGH(TABLA7SEG << 1)  
	LDI ZL, LOW(TABLA7SEG << 1)
	ADD ZL, R20			//AGREGA E INDICA QUE R20 INCIARÁ DESDE EL VALOR MÁS BAJO DE LA TABLA; ES DECIR, DESDE 0
	LPM R25, Z			// CARGA EL VALOR DE Z QUE SE LE CARGO EN LA LÍNEA 161 AL REGISTRO 18	
	OUT PORTD, R25		// MUESTRA EL VALOR DE R17 EN EL DISPLAY  
	
	CALL DELAY
	

	; UNIDADES DE HORAS, TERCER DÍGITO DE DISPLAY
	LDI		R16, 0b0000_0100	//ENCIENDE EL TERCER DISPLAY; ES DECIR, ENCIENDE EL TERCER TRANSISTOR EN A2, QUE MUESTRA UNIDADES DE HORAS
	OUT		PORTC, R16

	; CARGA DE VALORES DE LA TABLA DE 7 SEGMENTOS AL DISPLAY
	LDI ZH, HIGH(TABLA7SEG << 1)  
	LDI ZL, LOW(TABLA7SEG << 1)
	ADD ZL, R21			//AGREGA E INDICA QUE R21 INCIARÁ DESDE EL VALOR MÁS BAJO DE LA TABLA; ES DECIR, DESDE 0
	LPM R25, Z			// CARGA EL VALOR DE Z QUE SE LE CARGO EN LA LÍNEA 175 AL REGISTRO 18	
	OUT PORTD, R25		// MUESTRA EL VALOR DE R17 EN EL DISPLAY  
	
	CALL DELAY
	
	; DECENAS DE HORAS, CUARTO DÍGITO DE DISPLAY
	LDI		R16, 0b0000_0100	//ENCIENDE EL TERCER DISPLAY; ES DECIR, ENCIENDE EL TERCER TRANSISTOR EN A2, QUE MUESTRA UNIDADES DE HORAS
	OUT		PORTC, R16

	; CARGA DE VALORES DE LA TABLA DE 7 SEGMENTOS AL DISPLAY
	LDI ZH, HIGH(TABLA7SEG << 1)  
	LDI ZL, LOW(TABLA7SEG << 1)
	ADD ZL, R23			//AGREGA E INDICA QUE R23 INCIARÁ DESDE EL VALOR MÁS BAJO DE LA TABLA; ES DECIR, DESDE 0
	LPM R25, Z			// CARGA EL VALOR DE Z QUE SE LE CARGO EN LA LÍNEA 161 AL REGISTRO 18	
	OUT PORTD, R25		// MUESTRA EL VALOR DE R17 EN EL DISPLAY  
	
	CALL DELAY
	
	RJMP		MAIN_LOOP


;	HASTA AQUÍ ME QUEDÉ

MIN_UNITS_CONF:                //CADA MINUTO SE CAMBIA EL VALOR DEL DISPLAY 1
	LDI R17, 0
	INC R18
	RJMP MODO_CONF_HORA
MIN_DEC_CONF:                //CADA 10 MINUTOS SE CAMBIA EL VALOR PARA PONER LAS DECENAS 
	LDI R18, 0
	INC R19
	RJMP MODO_CONF_HORA
HORA_UNITS_CONF: 				// CADA 60 MINUTOS SE CAMBIA LA HORA 
	LDI R19, 0
	INC R20
	RJMP MODO_CONF_HORA
HORA_DEC_CONF:				//CCUANDO LLEGUE A 10 SE CAMBIAN LAS DECENAS 
	LDI R20, 0
	INC R21
	RJMP MODO_CONF_HORA
REST_24_CONF:
	CPI  R19, 4			//CUANDO ALCANCE LAS 24 HRS UNIDADES Y DECENAS DE HORAS
	BREQ RESET_ALL_CONF
	RJMP MODO_CONF_MOSTRAR_HORA
RESET_ALL_CONF: 
	LDI		R18, 0 // REGISTRO DE UNIDADES DE MINUTOS
	LDI		R19, 0 // REGISTRO DE DECENAS DE MINUTOS
	LDI		R20, 0 // REGISTRO DE UNIDADES DE HORAS
	LDI		R21, 0 // REGISTRO DE DECENAS DE HORAS
	INC		R22	   // REGISTRO PARA RESET
	RJMP	MODO_CONF_MOSTRAR_HORA

//****************************************************
//DELAYS
//****************************************************

DELAY:              //DELAY PARA MULTIPLEXACIÓN
	LDI R19, 255
DELAY1:
	DEC R19
	BRNE DELAY1 
	LDI R19, 255
DELAY2:
	DEC R19
	BRNE DELAY2
	LDI R19, 255
DELAY3:
	DEC R19
	BRNE DELAY3
	LDI R19, 255
DELAY4:
	DEC R19
	BRNE DELAY4

	RET


//****************************************************
//Subrutina 
//****************************************************
INT_PC:
	PUSH R16		//guardamos el valor de R16
	IN R16, SREG
	PUSH R16

	IN R16, PINB     //los valores del puerto B los almacenamos en R18
	SBRS R16, PORTB4		//analisis de los botones para aumentar conteo de leds Y AUMENTO  
	INC R20
	CPI R20, 2	// este cambio luego a 6  
	BRNE MODO_ESTADO
	LDI R20, 0
	JMP SALIR

MODO_ESTADO:
	CPI R20, 1
	BREQ MODO1_CONF_HORA
	JMP SALIR
	/*CPI R20, 3
	BREQ MODO3_CONF_FECHA
	CPI R20, 5
	BREQ MODO 5*/


//**************************************************** MODO 1 ****************************************************
MODO1_CONF_HORA:
	PUSHBUTTON_0: //ANÁLISIS DEL PRIMER BOTON
		SBRS R16, PORTB0
		JMP PUSHBUTTON_1
		INC R21

	PUSHBUTTON_1: //ANÁLISIS DEL SEGUNDO BOTON
		SBRS R16, PORTB1
		JMP PUSHBUTTON_2
		DEC R21
		CPI R21, -1
		BRNE PUSHBUTTON_2
		LDI R21, 9
		DEC R22
		CPI R22, -1
		BRNE SALIR
		LDI R22, 5
		JMP PUSHBUTTON_2


	PUSHBUTTON_2: //ANÁLISIS DEL TERCER BOTON
		SBRS R16, PORTB2
		JMP PUSHBUTTON_3
		INC R23

	PUSHBUTTON_3: //ANÁLISIS DEL CUARTO BOTON
		SBRS R16, PORTB3
		JMP SALIR
		DEC R23
		CPI R23, -1
		BRNE SALIR
		LDI R23, 3
		DEC R24
		CPI R24, -1
		BRNE SALIR
		LDI R24, 2
		JMP PUSHBUTTON_0


SALIR:

	SBI PCIFR, PCIF0

	POP R16
	OUT SREG, R16
	POP R16          //Devolvemos el valor antes guardado
	
	RETI            //retorno de interrupcion 

CONF_T1:
	LDI R16, 0
	STS TCCR1A, R16   //INICIAR TIMER 1 COMO CONTADOR
	
	LDI R16, (1<<CS02) | (1<<CS00)     //PREESCALER A 1024
	STS TCCR1B, R16       
	
	LDI R16, 0xE1
	STS TCNT1H, R16
	LDI R16, 0x7B
	STS TCNT1L, R16

	LDI R16, (1<<TOIE1)   //MASCARA TIMER 1
	STS TIMSK1, R16

	RET

TMR1_ISR:
	PUSH R16        //GUARDAR VALORES DE R16 EN LA PILA
 	IN R16, SREG
	PUSH R16
     
	LDI R17, 0xE1    
	STS TCNT1H, R17
	LDI R17, 0x7B      
	STS TCNT1L, R17   
	SBI TIFR1, TOV1
	
	INC R28         

	POP R16
	OUT SREG, R16  
	POP R16         //DEVOLVER VALORES ANTERIORES DE R16

	RETI		   //RETORNO DE INTERRUPCION

CONF_T0:
	LDI R16, 0
	OUT TCCR0A, R16      //inicializacion de timer 0 como contador 
	
	LDI R16, (1<<CS02) | (1<<CS00)     //seleccion de prescaler de 1024 
	OUT TCCR0B, R16       
	
	LDI R16, 100          //valor de conteo inicial 
	OUT TCNT0, R16

	LDI R16, (1<<TOIE0)   //mascara del timer0
	STS TIMSK0, R16

	RET

TMR0_ISR:
	PUSH R16        //guardamos el valor de R16
 	IN R16, SREG
	PUSH R16

	LDI R16, 100
	OUT TCNT0, R16      
	SBI TIFR0, TOV0
	
	INC R2           //realizamos el incremento en las unidades en cada interrupcion del timer0

	POP R16
	OUT SREG, R16  
	POP R16         //Devolvemos el valor antes guardado

	RETI		   //retorno de interrupcion 


//****************************************************























/*
******************************************************
 NON - INTERRUPT SUBROUTINES
*******************************************************
TMR0_ISR:
	LDI		R16, 124						// CARGA VALOR INICIAL DE TCNT0 A R16
	OUT		TCNT0, R16						// CARGA VALOR INICIAL A TCNT0
	INC		R17								// SE INCREMENTA 1 A 1
	CPI		R17, 124						// COMPARA EL REGISTRO R17 CON 100 ESTO PARA VERIFICAR SI EL VALOR LLEGÓ A 1S POR EL VALOR DE 100 DE TCNT0 QUE TAMBIÉN ES DE 100, POR OTRO LADO SI A R17 SE LE HUBIERA COMPARADO CON 50 SERÍA MEDIO SEGUNDO
	BRNE	SALIR_TMR0_ISR					// SALTA SI NO ES IGUAL A "SALIR_TMR0_ISR"
	CLR		R17								// SE PONE EN 0 EL REGISTRO R17 DE NUEVO
	
	 AQUÍ MOSTRARÁ EL VALOR DE 0 CADA 5ms EN EL DISPLAY
	LDI		ZL, LOW(TABLA7SEG << 1)
	LDI		ZH, HIGH(TABLA7SEG << 1)
	LPM		R16, Z				//Z INCLUYE ZL Y ZH
	OUT		PORTD, R16			//MUESTRA LOS VALORES DE ZL Y ZH EN EL PUERTO D
		ENCIENDE TODOS LOS DISPLAYS Y MUESTRA EL VALOR DE 0
	SBI		PORTC, PORTC1
	SBI		PORTC, PORTC0
	SBI		PORTC, PORTC2
	SBI		PORTC, PORTC3	
	RJMP	SALIR_TMR0_ISR


SALIR_TMR0_ISR:
	RETI


TMR1_ISR:
	LDI		R16, HIGH(0xC2F7)				// CARGA TCNT1H CON UN VALOR INICIAL
	STS		TCNT1H, R16					
	LDI		R16, LOW(0xC2F7)				// CARGA TCNT1L CON UN VALOR INICIAL
	STS		TCNT1L, R16
	LDI		R16, 0x00
	STS		TCCR1A, R16						// SETEA TMR1 AL MODO "NORMAL"	
	LDI		R16, (1 << CS11) | (1 << CS10)
	STS		TCCR1B, R16						// CONFIGURA EL PRESCALER A 64

 ************************************** UNIDADES DE SEGUNDOS **********************************************

	CPI		R18, 9							//COMPARA SI EL REGISTRO R18 LLEGA A 9 QUE ES EL ÚLTIMO DATO DE UNIDADES DE SEGUNDOS, SI LO ES SE SALTA A LA LÍNEA 127 QUE LIMPIA EL REGISTRO 18
	BRNE	INC_DISP_SECOND_UNITS			//SI NO ES 9 SALTA A INCREMENTO DE DISPLAY
	CLR		R18

************************************** DECENAS DE SEGUNDOS **********************************************

	CPI		R19, 5							//COMPARA SI EL REGISTRO R19 LLEGA A 5 QUE ES EL ÚLTIMO DATO DE DECENAS DE SEGUNDOS, SI LO ES SE SALTA A LA LÍNEA 139 QUE LIMPIA EL REGISTRO 19
	BRNE	INC_DISP_SECOND_TENS			//SI NO ES 5 SALTA A INCREMENTO DE DISPLAY
	CLR		R19

************************************** UNIDADES DE MINUTOS **********************************************

	CPI		R20, 9							//COMPARA SI EL REGISTRO R20 LLEGA A 9 QUE ES EL ÚLTIMO DATO DE UNIDADES DE MINUTOS, SI LO ES SE SALTA A LA LÍNEA 145 QUE LIMPIA EL REGISTRO 20
	BRNE	INC_DISP_MINUTE_UNITS			//SI NO ES 9 SALTA A INCREMENTO DE DISPLAY
	CLR		R20

************************************* DECENAS DE SEGUNDOS **********************************************

	CPI		R21, 5							//COMPARA SI EL REGISTRO R21 LLEGA A 5 QUE ES EL ÚLTIMO DATO DE DECENAS DE MINUTOS, SI LO ES SE SALTA A LA LÍNEA 151 QUE LIMPIA EL REGISTRO 21
	BRNE	INC_DISP_MINUTE_TENS			//SI NO ES 5 SALTA A INCREMENTO DE DISPLAY
	CLR		R21

************************************* UNIDADES DE HORAS **********************************************

	CPI		R22, 9							//COMPARA SI EL REGISTRO R22 LLEGA A 9 QUE ES EL ÚLTIMO DATO DE UNIDADES DE MINUTOS, SI LO ES SE SALTA A LA LÍNEA 157 QUE LIMPIA EL REGISTRO 22
	BRNE	INC_DISP_MINUTE_UNITS			//SI NO ES 9 SALTA A INCREMENTO DE DISPLAY
	CLR		R22

************************************** UNIDADES DE HORAS **********************************************

	;CPI		R23, 9							//COMPARA SI EL REGISTRO R21 LLEGA A 5 QUE ES EL ÚLTIMO DATO DE DECENAS DE MINUTOS, SI LO ES SE SALTA A LA LÍNEA 151 QUE LIMPIA EL REGISTRO 21
	;BRNE	INC_DISP_HOUR_UNITS			//SI NO ES 5 SALTA A INCREMENTO DE DISPLAY
	;CLR		R23

	RET

	

	**************************MUESTRA EN EL DISPLAY EL VALOR INICIAL DE 0***************************
	//LDI		ZL, LOW(TABLA7SEG << 1)
	//LDI		ZH, HIGH(TABLA7SEG << 1)
	//LPM		R16, Z				//Z INCLUYE ZL Y ZH
	// OUT		PORTD, R16			//MUESTRA LOS VALORES DE ZL Y ZH EN EL PUERTO D

SALIR_TMR1_ISR:
	RETI


INC_DISP_SECOND_UNITS:	
	LDI		ZL, LOW(TABLA7SEG << 1)
	LDI		ZH, HIGH(TABLA7SEG << 1)
	INC		R18					//INCREMENTA EL REGISTRO R18	
	ADD		ZL, R18				// AGREGA 1 VALOR MÁS AL REGISTRO R18
	LPM		R16, Z				// CARGA EL VALOR DE Z QUE SE LE CARGO EN LA LÍNEA 118 AL REGISTRO 16
	OUT		PORTD, R16			//MUESTRA LOS VALORES DE ZL Y ZH EN EL PUERTO D
	CBI		PORTC, PORTC1
	CBI		PORTC, PORTC0
	CBI		PORTC, PORTC2
	SBI		PORTC, PORTC3		
	RJMP	SALIR_TMR1_ISR
	

 INC_DISP_SECOND_TENS:
 	LDI		ZL, LOW(TABLA7SEG << 1)
	LDI		ZH, HIGH(TABLA7SEG << 1)
	INC		R19
	ADD		ZL, R19
	LPM		R16, Z				// CARGA EL VALOR DE Z QUE SE LE CARGO EN LA LÍNEA 118 AL REGISTRO 16
	OUT		PORTD, R16			// MUESTRA EN EL DISPLAY EL VALOR DE R16
	CBI		PORTC, PORTC3
	SBI		PORTC, PORTC2
	CBI		PORTC, PORTC1
	CBI		PORTC, PORTC0
	RJMP	SALIR_TMR1_ISR

INC_DISP_MINUTE_UNITS:
	LDI		ZL, LOW(TABLA7SEG << 1)
	LDI		ZH, HIGH(TABLA7SEG << 1)
	INC		R20
	ADD		ZL, R20
	LPM		R16, Z				// CARGA EL VALOR DE Z QUE SE LE CARGO EN LA LÍNEA 118 AL REGISTRO 16
	OUT		PORTD, R16			// MUESTRA EN EL DISPLAY EL VALOR DE R16
	CBI		PORTC, PORTC3
	CBI		PORTC, PORTC2
	SBI		PORTC, PORTC1
	CBI		PORTC, PORTC0
	RJMP	SALIR_TMR1_ISR

INC_DISP_MINUTE_TENS:
 	LDI		ZL, LOW(TABLA7SEG << 1)
	LDI		ZH, HIGH(TABLA7SEG << 1)
	INC		R21
	ADD		ZL, R21
	LPM		R16, Z				// CARGA EL VALOR DE Z QUE SE LE CARGO EN LA LÍNEA 118 AL REGISTRO 16
	OUT		PORTD, R16			//MUESTRA LOS VALORES DE ZL Y ZH EN EL PUERTO D
	CBI		PORTC, PORTC3
	CBI		PORTC, PORTC2
	CBI		PORTC, PORTC1
	SBI		PORTC, PORTC0
	RJMP	SALIR_TMR1_ISR

	
INC_DISP_HOUR_UNITS:
	LDI		ZL, LOW(TABLA7SEG << 1)
	LDI		ZH, HIGH(TABLA7SEG << 1)
	//CPI		R23,	2			// SI SE CUMPLE LA CONDICIÓN DE QUE R23 = 2, SE PROCEDE A COMPARAR SI R22 = 4
	INC		R22					// SI NO SE CUMPLE LA CONDICIÓN SE SIGUE INCREMENTANDO R22
	//CPI		R22,	4			// SI SE CUMPLE LA CONDICIÓN DE QUE R23 = 2, SE PROCEDE A COMPARAR SI R22 = 4, SI SE CUMPLEN AMBAS CONDICIONES SE LIMPIAN R22 Y R23 
	//INC		R22					// SI NO SE CUMPLE SIGUE INCREMENTANDO R22
	//CLR		R23					// SI SE CUMPLE LA CONDICIÓN DE QUE R23 = 2 Y R22 = 4 SE LIMPIARÁ EL R23 (DECENA DE HORAS)
	//CLR		R22					// SI SE CUMPLE LA CONDICIÓN DE QUE R23 = 2 Y R22 = 4 SE LIMPIARÁ EL R22 (UNIDADES DE HORAS)
	ADD		ZL, R22
	LPM		R16, Z				// CARGA EL VALOR DE Z QUE SE LE CARGO EN LA LÍNEA 118 AL REGISTRO 16
	OUT		PORTD, R16			// MUESTRA LOS VALORES DE ZL Y ZH EN EL PUERTO D
	CBI		PORTC, PORTC3
	CBI		PORTC, PORTC2
	SBI		PORTC, PORTC1
	CBI		PORTC, PORTC0
	RJMP	SALIR_TMR1_ISR

INC_DISP_HOUR_TENS:
 	LDI		ZL, LOW(TABLA7SEG << 1)
	LDI		ZH, HIGH(TABLA7SEG << 1)
	INC		R23
	ADD		ZL, R23
	LPM		R16, Z				// CARGA EL VALOR DE Z QUE SE LE CARGO EN LA LÍNEA 118 AL REGISTRO 16
	OUT		PORTD, R16			// MUESTRA LOS VALORES DE ZL Y ZH EN EL PUERTO D
	CBI		PORTC, PORTC3
	CBI		PORTC, PORTC2
	CBI		PORTC, PORTC1
	SBI		PORTC, PORTC0
	RJMP	SALIR_TMR1_ISR
*/

